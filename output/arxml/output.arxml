AUTOSAR XML (schema 4.0)
package /ECUC_1
  Os: ecuc-def-edition=4.2.0, implementation-config-variant=VARIANT-PRE-COMPILE
    3 x OsAppMode:
      OSDEFAULTAPPMODE
      MANUFACT_MODE
      HW_TEST_MODE
    OsOs: OsStatus=STANDARD
      OsHooks: OsErrorHook=FALSE, OsPostTaskHook=FALSE, OsPreTaskHook=FALSE, OsShutdownHook=FALSE, OsStartupHook=FALSE, OsProtectionHook=NOT YET SUPPORTED
      OsHookStack: OsHookStackSize=512
      FreeOsekParams: OsName=osek_os, CpuName=cortex-m4, IrqStackSize=512, ContextSaveSize=128, AppTasksSize=2560
    event1 (OsEvent)
    event2 (OsEvent)
    mSecCounter (OsCounter):
      OsCounterMaxAllowedValue = 0xFFFFFFFF
      OsCounterMinCycle = 1
      OsCounterTicksPerBase = 1
      TICKDURATION_not_supported = 1000000
      OsCounterType = NOT SUPPORTED BY FREEOSEK YET
    uSecCounter (OsCounter):
      OsCounterMaxAllowedValue = 0xFFFFFFFF
      OsCounterMinCycle = 100
      OsCounterTicksPerBase = 1
      TICKDURATION_not_supported = 1000
      OsCounterType = NOT SUPPORTED BY FREEOSEK YET
