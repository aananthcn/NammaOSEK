AUTOSAR XML
package /ECUC_1
  module config Os: ecuc-def-edition=4.2.0, implementation-config-variant=VARIANT-PRE-COMPILE
    3 x OsAppMode:
      OSDEFAULTAPPMODE
      MANUFACT_MODE
      HW_TEST_MODE
